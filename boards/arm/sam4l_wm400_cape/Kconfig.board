## boards/arm/sam4l_wm400_cape/Kconfig.board
```kconfig
# Peregrine WM-400 Board selection

# Copyright (c) 2020 Gerson Fernando Budke <nandojve@gmail.com>
# SPDX-License-Identifier: Apache-2.0

config BOARD_SAM4L_WM400_CAPE
	bool "Peregrine WM-400 Beagle Bone Black Cape"
	depends on SOC_PART_NUMBER_SAM4LC4B
```

## boards/arm/sam4l_wm400_cape/Kconfig.defconfig
```kconfig
# Atmel SAM4L WM-400 BBB Cape Board configuration

# Copyright (c) 2020 Gerson Fernando Budke <nandojve@gmail.com>
# SPDX-License-Identifier: Apache-2.0

if BOARD_SAM4L_WM400_CAPE

config BOARD
	default "sam4l_wm400_cape"

config IEEE802154_RF2XX
	default y
	depends on IEEE802154

endif # BOARD_SAM4L_WM400_CAPE
```

## boards/arm/sam4l_wm400_cape/sam4l_wm400_cape_defconfig
```kconfig
# SPDX-License-Identifier: Apache-2.0

CONFIG_BOARD_SAM4L_WM400_CAPE=y
CONFIG_SOC_PART_NUMBER_SAM4LC4B=y
CONFIG_SOC_SERIES_SAM4L=y
CONFIG_ARM_MPU=y
CONFIG_CORTEX_M_SYSTICK=y
CONFIG_GPIO=y
CONFIG_LED=y
CONFIG_SERIAL=y
CONFIG_SPI=y
CONFIG_WATCHDOG=n

CONFIG_CONSOLE=y
CONFIG_UART_CONSOLE=y
CONFIG_SHELL=y
CONFIG_DEVICE_SHELL=y
```

## boards/bouffalolab/bl6/bl604e_iot_dvk/board.yml
```yaml
board:
  name: bl604e_iot_dvk
  vendor: bouffalolab
  socs:
    - name: bl604e20q2i
```

## boards/bouffalolab/bl60x/ai_wb2_12f/Kconfig.ai_wb2_12f
```kconfig
# Copyright (c) 2021 ATL Electronics
# SPDX-License-Identifier: Apache-2.0

config BOARD_AI_WB2_12F
	select SOC_BL602C00Q2I
```

## boards/bouffalolab/bl60x/dt_bl10_devkit/board.yml
```yaml
board:
  name: dt_bl10_devkit
  vendor: bouffalolab
  socs:
    - name: bl602c20q2i
```

## boards/bouffalolab/bl70x/xt_bl_zb1/Kconfig.xt_bl_zb1
```kconfig
# Bouffalolab BL702
# Copyright (c) 2024 MASSDRIVER EI (massdriver.space)
# SPDX-License-Identifier: Apache-2.0

config BOARD_XT_BL_ZB1
	bool "BL702 zigbee module"
	select SOC_BL702C10Q2H
```

## boards/riscv/ai_wb2_12f/Kconfig.board
```kconfig
# Bouffalo Lab BL602 DevKit
#
# Copyright (c) 2021 ATL Electronics
# SPDX-License-Identifier: Apache-2.0

config BOARD_AI_WB2_12F
	bool "2.4GHz Wi-Fi and BLE coexistence Module Development Kit"
	depends on SOC_PART_NUMBER_BL602C00Q2I
```

## boards/riscv/ai_wb2_12f/Kconfig.defconfig
```kconfig
# Bouffalo Lab BL602 DevKit
#
# Copyright (c) 2021 ATL Electronics
# SPDX-License-Identifier: Apache-2.0

if BOARD_AI_WB2_12F

config BOARD
	default "ai_wb2_12f"

endif   # BOARD_AI_WB2_12F
```

## boards/riscv/ai_wb2_12f/ai_wb2_12f_defconfig
```kconfig
# Copyright (c) 2024, MASSDRIVER EI (massdriver.space)
# SPDX-License-Identifier: Apache-2.0

CONFIG_SOC_SERIES_BL6=y
CONFIG_SOC_PART_NUMBER_BL602C00Q2I=y
CONFIG_BOARD_AI_WB2_12F=y

CONFIG_CONSOLE=y
CONFIG_UART_CONSOLE=y
CONFIG_SERIAL=y
```

## boards/shields/esp_8266/boards/sam4l_wm400_cape.conf
```kconfig
#
# Copyright (c) 2020 Gerson Fernando Budke <nandojve@gmail.com>
#
# SPDX-License-Identifier: Apache-2.0

CONFIG_NET_TX_STACK_SIZE=1024
CONFIG_NET_RX_STACK_SIZE=1024

CONFIG_NET_PKT_RX_COUNT=6
CONFIG_NET_PKT_TX_COUNT=6
CONFIG_NET_BUF_RX_COUNT=10
CONFIG_NET_BUF_TX_COUNT=10
CONFIG_NET_MAX_CONTEXTS=5
```

## boards/st/nucleo_u5a5zj_q/Kconfig.defconfig
```kconfig
# Copyright (c) 2025
# SPDX-License-Identifier: Apache-2.0

if BOARD_NUCLEO_U5A5ZJ_Q

config USE_DT_CODE_PARTITION
	default y if TRUSTED_EXECUTION_NONSECURE

if BUILD_WITH_TFM

# Initial Attestation key provisioned by the BL1 bootloader
config TFM_INITIAL_ATTESTATION_KEY
	default y

config TFM_DUMMY_PROVISIONING
	default n

endif # BUILD_WITH_TFM

endif # BOARD_NUCLEO_U5A5ZJ_Q
```

## boards/st/nucleo_u5a5zj_q/nucleo_u5a5zj_q_stm32u5a5xx_ns_defconfig
```kconfig
# SPDX-License-Identifier: Apache-2.0

# enable uart driver
CONFIG_SERIAL=y

# enable GPIO
CONFIG_GPIO=y

# console
CONFIG_CONSOLE=y
CONFIG_UART_CONSOLE=y

# Enable MPU
CONFIG_ARM_MPU=y

# Enable HW stack protection
CONFIG_HW_STACK_PROTECTION=y

# TF-M
CONFIG_ARM_TRUSTZONE_M=y
CONFIG_RUNTIME_NMI=y
CONFIG_TRUSTED_EXECUTION_NONSECURE=y

CONFIG_TFM_MCUBOOT_SIGNATURE_TYPE="RSA-3072"
```

## drivers/i2c/Kconfig.bflb
```kconfig
# Copyright (c) 2024 MASSDRIVER EI (massdriver.space)
# SPDX-License-Identifier: Apache-2.0

config I2C_BFLB
	bool "Bouffalolab I2C driver"
	default y
	depends on DT_HAS_BFLB_I2C_ENABLED
	select RING_BUFFER
	help
	  Enable I2C support for Bouffalolab Platforms
```

## dts/bindings/gpio/bflb,bl-gpio.yaml
```yaml
# Copyright (c) 2021-2024 Gerson Fernando Budke <nandojve@gmail.com>
# SPDX-License-Identifier: Apache-2.0

description: Bouffalo Lab GPIO node

compatible: "bflb,bl-gpio"

include:
  - name: base.yaml
  - name: gpio-controller.yaml

properties:
    reg:
      required: true

    interrupts:
      required: true

    "#gpio-cells":
      const: 2

gpio-cells:
  - pin
  - flags
```

## dts/bindings/i2c/bflb,i2c.yaml
```yaml
# Copyright (c) 2024 MASSDRIVER EI (massdriver.space)
# SPDX-License-Identifier: Apache-2.0

description: Bouffalolab I2C interface

compatible: "bflb,i2c"

include: [i2c-controller.yaml, pinctrl-device.yaml]

properties:
  reg:
    required: true
```

## dts/bindings/morse/zephyr,morse-gpio-rx.yaml
```yaml
# Copyright (c) 2025 Freedom Veiculos Eletricos
# Copyright (c) 2025 OS Systems
# SPDX-License-Identifier: Apache-2.0

description: Morse Code bitbang RX driver

compatible: "zephyr,morse-gpio-rx"

include:
  - name: base.yaml

properties:
  gpios:
    type: phandle-array
    required: true
    description: The GPIO configuration which will be used as rx interface.
```

## dts/bindings/usb/st,stm32-otgfs.yaml
```yaml
# Copyright (c) 2017, I-SENSE group of ICCS
# SPDX-License-Identifier: Apache-2.0

description: STM32 OTGFS controller

compatible: "st,stm32-otgfs"

include: [usb-ep.yaml, pinctrl-device.yaml]

properties:
  reg:
    required: true

  interrupts:
    required: true

  pinctrl-0:
    required: true

  pinctrl-names:
    required: true

  ram-size:
    type: int
    required: true
    description: |
      Size of USB dedicated RAM. STM32 SOC's reference
      manual defines a shared FIFO size.

  phys:
    type: phandle
    description: PHY provider specifier

  clocks:
    required: true

  vbus-sensing:
    type: boolean
    description: |
      Enable VBUS sensing via the OTG controller's internal comparator.
      When set, the driver enables the HAL VBUS comparator and advertises
      the VBUS detection capability. The VBUS pin must also be included
      in pinctrl-0 to route the voltage to the comparator input.
```

## dts/bindings/usb/st,stm32-otghs-common.yaml
```yaml
# Copyright (c) 2025, STMicroelectronics
# SPDX-License-Identifier: Apache-2.0

# Common fields for STM32 OTGHS controller

include: [usb-ep.yaml, pinctrl-device.yaml]

properties:
  reg:
    required: true

  interrupts:
    required: true

  ram-size:
    type: int
    required: true
    description: |
      Size of USB dedicated RAM. STM32 SOC's reference
      manual defines a shared FIFO size.

  phys:
    type: phandle
    description: PHY provider specifier

  clocks:
    required: true

  vbus-sensing:
    type: boolean
    description: |
      Enable VBUS sensing via the OTG controller's internal comparator.
      When set, the driver enables the HAL VBUS comparator and advertises
      the VBUS detection capability. The VBUS pin must also be included
      in pinctrl-0 to route the voltage to the comparator input.
```

## modules/hal_bouffalolab/Kconfig
```kconfig
# Copyright (c) 2021-2024 ATL Electronics
# Copyright (c) 2024 MASSDRIVER EI (massdriver.space)
# SPDX-License-Identifier: Apache-2.0

config ZEPHYR_HAL_BOUFFALOLAB_MODULE
	bool
```

## samples/net/sockets/echo_client/boards/sam4l_wm400_cape.conf
```kconfig
# Copyright (c) 2020, Gerson Fernando Budke
#
# SPDX-License-Identifier: Apache-2.0
#

CONFIG_BT=n

# Disable TCP and IPv4 (TCP disabled to avoid heavy traffic)
CONFIG_NET_TCP=n
CONFIG_NET_IPV4=n
CONFIG_NET_6LO=y
CONFIG_NET_L2_IEEE802154=y
CONFIG_NET_L2_IEEE802154_SHELL=y
CONFIG_NET_L2_IEEE802154_FRAGMENT=y
CONFIG_NET_L2_IEEE802154_FRAGMENT_REASS_CACHE_SIZE=2
CONFIG_NET_L2_IEEE802154_SECURITY=n
CONFIG_NET_L2_IEEE802154_LOG_LEVEL_INF=y

CONFIG_IEEE802154=y
CONFIG_IEEE802154_RF2XX=y

CONFIG_NET_CONFIG_NEED_IPV6=y
CONFIG_NET_CONFIG_NEED_IPV4=n
CONFIG_NET_CONFIG_MY_IPV6_ADDR="2001:db8::2"
CONFIG_NET_CONFIG_PEER_IPV6_ADDR="2001:db8::1"
CONFIG_NET_CONFIG_IEEE802154_DEV_NAME="RF2XX_0"
CONFIG_NET_CONFIG_IEEE802154_CHANNEL=26

# Reduced buffers to fit into SAM4L SoC
CONFIG_CPLUSPLUS=n

CONFIG_NET_PKT_RX_COUNT=10
CONFIG_NET_PKT_TX_COUNT=10
CONFIG_NET_BUF_RX_COUNT=10
CONFIG_NET_BUF_TX_COUNT=10
CONFIG_NET_MAX_CONTEXTS=6
CONFIG_NET_MAX_CONN=2
CONFIG_NET_MAX_ROUTES=4
CONFIG_NET_MAX_NEXTHOPS=2

CONFIG_SHELL_STACK_SIZE=1024
CONFIG_SHELL_CMD_BUFF_SIZE=80
CONFIG_SHELL_ARGC_MAX=6
CONFIG_SHELL_HISTORY_BUFFER=256
```
