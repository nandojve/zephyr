## CMakeLists.txt
```
# SPDX-License-Identifier: Apache-2.0

cmake_minimum_required(VERSION 3.13.1)
find_package(Zephyr REQUIRED HINTS $ENV{ZEPHYR_BASE})
project(tagoio_http_client)

target_sources(app PRIVATE src/main.c)
target_sources(app PRIVATE src/sockets.c)
target_sources_ifdef(CONFIG_WIFI app PRIVATE src/wifi.c)

set(gen_dir ${ZEPHYR_BINARY_DIR}/include/generated/)

generate_inc_file_for_target(
    app
    src/https-cert.der
    ${gen_dir}/https-cert.der.inc
    )
```

## Kconfig
```
#  Copyright (c) 2020 Gerson Fernando Budke <nandojve@gmail.com>
#  SPDX-License-Identifier: Apache-2.0

mainmenu "TagoIO IoT Platform (HTTP/S) Client Configuration"

menu "TagoIO IoT Configuration"

config TAGOIO_MANUAL_SERVER
	bool "Disable DNS lookup"
	default n

config TAGOIO_API_SERVER_IP
	string "TagoIO Main Server"
	depends on TAGOIO_MANUAL_SERVER
	default "75.2.65.153"

config TAGOIO_DEVICE_TOKEN
	string "The Device Identification Token"
	default "device_token"

config TAGOIO_HTTP_POOL_INTERVAL
	int "Configure polling interval in seconds to send data"
	range 1 512
	default 10

config TAGOIO_HTTP_CONN_TIMEOUT
	int "Configure http request timeout in seconds"
	range 1 120
	default 10

if WIFI
config TAGOIO_HTTP_WIFI_SSID
	string "WIFI SSID - Network name"
	default "my_network"
config TAGOIO_HTTP_WIFI_PSK
	string "WIFI PSK - Network password key"
	default "secret_passwd"
endif

module = TAGOIO_HTTP
module-str = Log level for TagoIO IoT Platform
module-help = Enables logging for TagoIO IoT Platform.
source "subsys/logging/Kconfig.template.log_config"

endmenu

source "Kconfig.zephyr"
```

## sample.yaml
```
common:
  tags: net http tagoio_http_client
  min_ram: 32
sample:
  description: TagoIO HTTP(S) client sample
  name: tagoio_http_client
tests:
  sample.net.sockets.tagoio_http_client:
    harness: net
```

## prj.conf
```kconfig
# App stack
CONFIG_MAIN_STACK_SIZE=16384

# C Library
# Default use minimal libc and with MINIMAL_LIBC_MALLOC_ARENA_SIZE defining
# HEAP size (512 bytes) are enought to run DNS.
CONFIG_MINIMAL_LIBC_MALLOC_ARENA_SIZE=16384
# C newlib
#CONFIG_NEWLIB_LIBC=y
#CONFIG_NEWLIB_LIBC_FLOAT_PRINTF=y
#CONFIG_HEAP_MEM_POOL_SIZE=16384

# Networking config
CONFIG_NETWORKING=y
CONFIG_NET_IPV4=y
CONFIG_NET_IPV6=n
CONFIG_NET_TCP=y
CONFIG_NET_SHELL=y

# Sockets
CONFIG_NET_SOCKETS=y
CONFIG_NET_SOCKETS_POSIX_NAMES=y
CONFIG_NET_SOCKETS_POLL_MAX=4

# Network driver config
CONFIG_TEST_RANDOM_GENERATOR=y

# Network address config
CONFIG_NET_CONFIG_SETTINGS=y
CONFIG_NET_CONFIG_NEED_IPV4=y
CONFIG_NET_DHCPV4=y

# Resolver
CONFIG_DNS_RESOLVER=y

# HTTP
CONFIG_HTTP_CLIENT=y

# Network debug config
CONFIG_LOG=y
CONFIG_LOG_IMMEDIATE=y
CONFIG_NET_LOG=n
CONFIG_NET_SOCKETS_LOG_LEVEL_DBG=n
CONFIG_NET_HTTP_LOG_LEVEL_DBG=n

# west build -b sam4e_xpro samples/net/sockets/tagoio_http_client -- -DCONF_FILE="prj.conf overlay-wifi.conf" -DSHIELD=esp_8266

# TagoIO API
CONFIG_TAGOIO_DEVICE_TOKEN="<your device token API>"
CONFIG_TAGOIO_HTTP_LOG_LEVEL_DBG=n
```

## overlay-wifi.conf
```kconfig
CONFIG_WIFI=y
# WiFi offload drivers don't resolve DNS, so use manual IP
CONFIG_TAGOIO_MANUAL_SERVER=y
CONFIG_TAGOIO_HTTP_WIFI_SSID="<your network id>"
CONFIG_TAGOIO_HTTP_WIFI_PSK="<yout network passwd>"

CONFIG_NET_CONFIG_SETTINGS=n
CONFIG_NET_DHCPV4=n
```

## src/main.c
```c
/*
 * Copyright (c) 2020 Gerson Fernando Budke <nandojve@gmail.com>
 *
 * SPDX-License-Identifier: Apache-2.0
 */

#include <logging/log.h>
LOG_MODULE_REGISTER(tagoio, CONFIG_TAGOIO_HTTP_LOG_LEVEL);

#include <zephyr.h>
#include <net/socket.h>
#include <net/http_client.h>
#include <random/rand32.h>
#include <stdio.h>

#include "ca_certificate.h"
#include "wifi.h"
#include "sockets.h"

static struct tagoio_context_t ctx;

static void response_cb(struct http_response *rsp,
			enum http_final_call final_data,
			void *user_data)
{
	if (final_data == HTTP_DATA_MORE) {
		LOG_DBG("Partial data received (%zd bytes)", rsp->data_len);
	} else if (final_data == HTTP_DATA_FINAL) {
		LOG_DBG("All the data received (%zd bytes)", rsp->data_len);
	}

	LOG_DBG("Response status %s", rsp->http_status);
}

static int collect_data(void)
{
	#define lower  20000
	#define upper 100000
	#define base    1000.00f

	float temp;
	int size;

	/* Generate a temperature between 20 and 100 celsius degree */
	temp = ((sys_rand32_get() % (upper - lower + 1)) + lower);
	ctx.raw_temperature = temp / base;

	size = snprintf(ctx.payload, sizeof(ctx.payload),
			"{\"variable\": \"temperature\","
			"\"unit\": \"c\",\"value\": %f}",
			ctx.raw_temperature);

	LOG_INF("%s", ctx.payload);

	return 0;
}

static void next_turn(void)
{
	if (collect_data() < 0) {
		LOG_INF("Error collecting data.");
		return;
	}

	if (tagoio_connect(&ctx) < 0) {
		LOG_INF("No connection available.");
		return;
	}

	if (tagoio_http_push(&ctx, response_cb) < 0) {
		LOG_INF("Error pushing data.");
		return;
	}
}

void main(void)
{
	printf("\n");
	LOG_INF("TagoIO IoT - HTTP Client - Temperature demo");

	wifi_connect();

	while (true) {
		next_turn();

		k_sleep(K_SECONDS(CONFIG_TAGOIO_HTTP_POOL_INTERVAL));
	}
}
```

## src/sockets.c
```c
/*
 * Copyright (c) 2020 Gerson Fernando Budke <nandojve@gmail.com>
 *
 * SPDX-License-Identifier: Apache-2.0
 */

#include <logging/log.h>
LOG_MODULE_DECLARE(tagoio, CONFIG_TAGOIO_HTTP_LOG_LEVEL);

#include <net/net_ip.h>
#include <net/socket.h>
#include <net/socketutils.h>
#include <net/dns_resolve.h>
#include <net/tls_credentials.h>
#include <net/http_client.h>

#include "sockets.h"

#if IS_ENABLED(CONFIG_TAGOIO_MANUAL_SERVER)
#define TAGOIO_SERVER CONFIG_TAGOIO_API_SERVER_IP
#else
#define TAGOIO_SERVER "api.tago.io"
#endif

#define TAGOIO_URL          "/data"
#define HTTP_PORT              "80"
#define HTTPS_PORT            "443"

static const char *tagoio_http_headers[] = {
	"Device-Token: " CONFIG_TAGOIO_DEVICE_TOKEN "\r\n",
	"Content-Type: application/json\r\n",
	"_ssl: false\r\n",
	NULL
};

int tagoio_connect(struct tagoio_context_t *ctx)
{
	struct addrinfo *addr;
	struct addrinfo hints;
	char hr_addr[NET_IPV6_ADDR_LEN];
	char *port;
	int dns_attempts = 3;
	int ret = -1;

	memset(&hints, 0, sizeof(hints));

	hints.ai_socktype = SOCK_STREAM;
	hints.ai_protocol = IPPROTO_TCP;
	if (IS_ENABLED(CONFIG_NET_IPV6)) {
		hints.ai_family = AF_INET6;
	} else if (IS_ENABLED(CONFIG_NET_IPV4)) {
		hints.ai_family = AF_INET;
	}

	if (IS_ENABLED(CONFIG_NET_SOCKETS_SOCKOPT_TLS)) {
		port = HTTPS_PORT;
	} else {
		port = HTTP_PORT;
	}

	while (dns_attempts--) {
		ret = getaddrinfo(TAGOIO_SERVER, port, &hints, &addr);
		if (ret == 0) {
			break;
		}
		k_sleep(K_SECONDS(1));
	}

	if (ret < 0) {
		LOG_ERR("Could not resolve dns, error: %d", ret);
		return ret;
	}

	LOG_DBG("%s address: %s",
		(addr->ai_family == AF_INET ? "IPv4" : "IPv6"),
		log_strdup(net_addr_ntop(addr->ai_family,
					 &net_sin(addr->ai_addr)->sin_addr,
					 hr_addr, sizeof(hr_addr))));

	ctx->sock = socket(hints.ai_family,
			   hints.ai_socktype,
			   hints.ai_protocol);
	if (ctx->sock < 0) {
		LOG_ERR("Failed to create %s HTTP socket (%d)",
			(addr->ai_family == AF_INET ? "IPv4" : "IPv6"),
			-errno);

		freeaddrinfo(addr);
		return -errno;
	}

	if (connect(ctx->sock, addr->ai_addr, addr->ai_addrlen) < 0) {
		LOG_ERR("Cannot connect to %s remote (%d)",
			(addr->ai_family == AF_INET ? "IPv4" : "IPv6"),
			-errno);

		freeaddrinfo(addr);
		return -errno;
	}

	freeaddrinfo(addr);

	return 0;
}

int tagoio_http_push(struct tagoio_context_t *ctx,
		     http_response_cb_t resp_cb)
{
	struct http_request req;
	int ret;

	memset(&req, 0, sizeof(req));

	req.method		= HTTP_POST;
	req.host		= TAGOIO_SERVER;
	req.port		= HTTP_PORT;
	req.url			= TAGOIO_URL;
	req.header_fields	= tagoio_http_headers;
	req.protocol		= "HTTP/1.1";
	req.response		= resp_cb;
	req.payload		= ctx->payload;
	req.payload_len		= strlen(ctx->payload);
	req.recv_buf		= ctx->resp;
	req.recv_buf_len	= sizeof(ctx->resp);

	ret = http_client_req(ctx->sock, &req,
			      CONFIG_TAGOIO_HTTP_CONN_TIMEOUT * MSEC_PER_SEC,
			      ctx);

	close(ctx->sock);
	ctx->sock = -1;

	return ret;
}
```

## src/sockets.h
```c
/*
 * Copyright (c) 2020 Gerson Fernando Budke <nandojve@gmail.com>
 *
 * SPDX-License-Identifier: Apache-2.0
 */

#define TAGOIO_SOCKET_MAX_BUF_LEN 1280

struct tagoio_context_t {
	int sock;
	float raw_temperature;
	uint8_t payload[TAGOIO_SOCKET_MAX_BUF_LEN];
	uint8_t resp[TAGOIO_SOCKET_MAX_BUF_LEN];
};

int tagoio_connect(struct tagoio_context_t *ctx);
int tagoio_http_push(struct tagoio_context_t *ctx,
		     http_response_cb_t resp_cb);
```

## src/wifi.c
```c
/*
 * Copyright (c) 2020 Gerson Fernando Budke <nandojve@gmail.com>
 *
 * SPDX-License-Identifier: Apache-2.0
 */

#include <logging/log.h>
LOG_MODULE_DECLARE(tagoio, CONFIG_TAGOIO_HTTP_LOG_LEVEL);

#include <net/wifi_mgmt.h>

static int connected;
static struct net_mgmt_event_callback wifi_shell_mgmt_cb;

static void handle_wifi_connect_result(struct net_mgmt_event_callback *cb)
{
	const struct wifi_status *status = (const struct wifi_status *)
					   cb->info;

	if (status->status) {
		LOG_ERR("Connection request failed (%d)", status->status);
	} else {
		LOG_INF("WIFI Connected");
		connected = 1;
	}
}

static void wifi_mgmt_event_handler(struct net_mgmt_event_callback *cb,
				    uint32_t mgmt_event, struct net_if *iface)
{
	switch (mgmt_event) {
	case NET_EVENT_WIFI_CONNECT_RESULT:
		handle_wifi_connect_result(cb);
		break;
	default:
		break;
	}
}

void wifi_connect(void)
{
	net_mgmt_init_event_callback(&wifi_shell_mgmt_cb,
				     wifi_mgmt_event_handler,
				     NET_EVENT_WIFI_CONNECT_RESULT);

	net_mgmt_add_event_callback(&wifi_shell_mgmt_cb);

	struct net_if *iface = net_if_get_default();
	static struct wifi_connect_req_params cnx_params = {
		.ssid = CONFIG_TAGOIO_HTTP_WIFI_SSID,
		.ssid_length = 0,
		.psk = CONFIG_TAGOIO_HTTP_WIFI_PSK,
		.psk_length = 0,
		.channel = 0,
		.security = WIFI_SECURITY_TYPE_PSK,
	};

	cnx_params.ssid_length = strlen(CONFIG_TAGOIO_HTTP_WIFI_SSID);
	cnx_params.psk_length = strlen(CONFIG_TAGOIO_HTTP_WIFI_PSK);

	connected = 0;

	LOG_INF("WIFI try connecting to %s...", CONFIG_TAGOIO_HTTP_WIFI_SSID);

	if (net_mgmt(NET_REQUEST_WIFI_CONNECT, iface,
		     &cnx_params, sizeof(struct wifi_connect_req_params))) {
		return;
	}

	while (connected == 0) {
		k_msleep(100);
	};
}
```
