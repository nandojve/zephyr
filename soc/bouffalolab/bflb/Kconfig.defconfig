## soc/bouffalolab/bflb/Kconfig.defconfig
```kconfig
# Copyright (c) 2021, ATL Electronics
# SPDX-License-Identifier: Apache-2.0

if SOC_FAMILY_BFLB

rsource "*/Kconfig.defconfig"

config PINCTRL
	default y

endif # SOC_FAMILY_BFLB
```

## soc/bouffalolab/bflb/bl6/Kconfig
```kconfig
# Copyright (c) 2021, ATL Electronics
# SPDX-License-Identifier: Apache-2.0

config SOC_SERIES_BL6
	select RISCV
#	select RISCV_GP
	select RISCV_HAS_CPU_IDLE
	select RISCV_MACHINE_TIMER
	select ATOMIC_OPERATIONS_C
	select COMPRESSED_ISA
	select CPU_HAS_FPU
	select INCLUDE_RESET_VECTOR
	select XIP
#	select RISCV_HAS_CLIC
#	select RISCV_VECTORED_MODE
#	select RISCV_SOC_INTERRUPT_INIT

	select RISCV_ISA_RV32I
	select RISCV_ISA_EXT_M
	select RISCV_ISA_EXT_A
	select RISCV_ISA_EXT_C
	select RISCV_ISA_EXT_ZICSR
	select RISCV_ISA_EXT_ZIFENCEI
```

## soc/bouffalolab/bflb/bl6/Kconfig.defconfig
```kconfig
# Copyright (c) 2021, ATL Electronics
# SPDX-License-Identifier: Apache-2.0

if SOC_SERIES_BL6

config SYS_CLOCK_HW_CYCLES_PER_SEC
	default 10000000

config NUM_IRQS
	default 64

endif   # SOC_SERIES_BL6
```

## soc/bouffalolab/bflb/bl6/Kconfig.soc
```kconfig
# Copyright (c) 2021, ATL Electronics
# SPDX-License-Identifier: Apache-2.0

config SOC_SERIES_BL6
	bool
	select SOC_FAMILY_BFLB
	help
	  Enable support for BouffaloLab BL6xx MCU series

config SOC_SERIES
	default "bl6" if SOC_SERIES_BL6

config SOC_BL602C00Q2I
	bool
	select SOC_SERIES_BL6

config SOC_BL602C20Q2I
	bool
	select SOC_SERIES_BL6

config SOC_BL604E20Q2I
	bool
	select SOC_SERIES_BL6

config SOC
	default "bl602c00q2i" if SOC_BL602C00Q2I
	default "bl602c20q2i" if SOC_BL602C20Q2I
	default "bl604e20q2i" if SOC_BL604E20Q2I
```

## soc/bouffalolab/bflb/bl60x/Kconfig.soc
```kconfig
# Copyright (c) 2021-2024 ATL Electronics
# Copyright (c) 2024 MASSDRIVER EI (massdriver.space)
# SPDX-License-Identifier: Apache-2.0

config SOC_SERIES_BL60X
	bool
	select SOC_FAMILY_BFLB
	help
	  Enable support for BouffaloLab BL6xx MCU series

config SOC_SERIES
	default "bl60x" if SOC_SERIES_BL60X

config SOC_BL602C00Q2I
	bool
	select SOC_SERIES_BL60X

config SOC_BL602C20Q2I
	bool
	select SOC_SERIES_BL60X

config SOC_BL604E20Q2I
	bool
	select SOC_SERIES_BL60X

config SOC
	default "bl602c00q2i" if SOC_BL602C00Q2I
	default "bl602c20q2i" if SOC_BL602C20Q2I
	default "bl604e20q2i" if SOC_BL604E20Q2I
```

## soc/bouffalolab/bl70x/Kconfig.defconfig
```kconfig
# Copyright (c) 2021, ATL Electronics
# SPDX-License-Identifier: Apache-2.0

if SOC_SERIES_BL70X

# on sifive e24, mtime is a fixed 1 000 000 per second rate.
# riscv_machine_timer uses mtime as if it was mcycle and expects
config SYS_CLOCK_HW_CYCLES_PER_SEC
	default 1000000

config SYS_CLOCK_TICKS_PER_SEC
	default 1000

config NUM_IRQS
	default 80

config ARCH_SW_ISR_TABLE_ALIGN
	default 64

config RISCV_MCAUSE_EXCEPTION_MASK
	default 0x3FF

endif   # SOC_SERIES_BL70X
```

## subsys/morse/Kconfig
```kconfig
# Copyright (c) 2024-2025 Freedom Veiculos Eletricos
# Copyright (c) 2024-2025 OS Systems
# SPDX-License-Identifier: Apache-2.0

menuconfig MORSE
	bool "Morse Code support [EXPERIMENTAL]"
	depends on COUNTER
	depends on DT_HAS_ZEPHYR_MORSE_ENABLED
	select EXPERIMENTAL
	help
	  This option enables Morse Code support.

if MORSE

module = MORSE
module-str = Morse Code
source "subsys/logging/Kconfig.template.log_config"

config MORSE_SHELL
	bool "Morse Code shell"
	depends on SHELL
	help
	  Enable Morse Code related shell commands.

endif # MORSE
```
